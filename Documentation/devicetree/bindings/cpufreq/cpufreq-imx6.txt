## Documentation/devicetree/bindings/cpufreq/cpufreq-imx6.txt
```
i.MX6 cpufreq driver
-------------------

i.MX6 SoC cpufreq driver for CPU frequency scaling.

This binding doc defines properties that must be put in the /cpus/cpu@0 node,
please refer to Documentation/devicetree/bindings/cpufreq/cpufreq-cpu0.txt
for detail.

Required properties:
- operating-points: Refer to Documentation/devicetree/bindings/power/opp.txt
  for details.
- clocks: Specify clocks that need to be used when cpu frequency is scaled,
  refer to Documentation/devicetree/bindings/clock/clock-bindings.txt for
  details.
- clock-names: List of clock input name strings sorted in the same order as the
  clocks property, refer to Documentation/devicetree/bindings/clock/clock-bindings.txt
  for details.
- xxx-supply: Input voltage supply regulator, refer to
  Documentation/devicetree/bindings/regulator/regulator.txt for details.
  arm-supply: regulator node supplying arm.
  pu-supply: regulator node supplying pu.
  soc-supply: regulator node supplying soc.

Optional properties:
- fsl,soc-operating-points: Specify vddsoc/pu voltage settings that must
  go with cpu0's operating-points.
- clock-latency: Specify the possible maximum transition latency for clock,
  in unit of nanoseconds.

Examples:

	cpu@0 {
		operating-points = <
			/* kHz    uV */
			1200000 1275000
			996000  1250000
			792000  1150000
			396000  975000
		>;
		fsl,soc-operating-points = <
			/* ARM kHz  SOC-PU uV */
			1200000 1275000
			996000	1250000
			792000	1175000
			396000	1175000
		>;
		clock-latency = <61036>; /* two CLK32 periods */
		clocks = <&clks 104>, <&clks 6>, <&clks 16>,
			 <&clks 17>, <&clks 170>;
		clock-names = "arm", "pll2_pfd2_396m", "step",
			      "pll1_sw", "pll1_sys";
		arm-supply = <&reg_arm>;
		pu-supply = <&reg_pu>;
		soc-supply = <&reg_soc>;
	};
```

## drivers/cec/Kconfig
```kconfig
#
# Consumer Electroncs Control support
#

menu "Consumer Electronics Control devices"

config CEC
	bool

config HDMI_CEC_CORE
	tristate
	select CEC

endmenu
```

## drivers/gpu/drm/bridge/Kconfig
```kconfig
config DRM_DW_HDMI
	tristate
	depends on DRM
	select DRM_KMS_HELPER

config DRM_DW_HDMI_AHB_AUDIO
	tristate "Synopsis Designware AHB Audio interface"
	depends on DRM_DW_HDMI && SND
	select SND_PCM
	select SND_PCM_ELD
	select SND_PCM_IEC958
	help
	  Support the AHB Audio interface which is part of the Synopsis
	  Designware HDMI block.  This is used in conjunction with
	  the i.MX6 HDMI driver.

config DRM_DW_HDMI_CEC
	tristate "Synopsis Designware CEC interface"
	depends on DRM_DW_HDMI != n
	select HDMI_CEC_CORE
	help
	  Support the CEC interface which is part of the Synposis
	  Designware HDMI block.  This is used in conjunction with
	  the Synopsis Designware HDMI driver.

config DRM_PTN3460
	tristate "PTN3460 DP/LVDS bridge"
	depends on DRM
	depends on OF
	select DRM_KMS_HELPER
	select DRM_PANEL
	---help---
	  ptn3460 eDP-LVDS bridge chip driver.

config DRM_PS8622
	tristate "Parade eDP/LVDS bridge"
	depends on DRM
	depends on OF
	select DRM_PANEL
	select DRM_KMS_HELPER
	select BACKLIGHT_LCD_SUPPORT
	select BACKLIGHT_CLASS_DEVICE
	---help---
	  parade eDP-LVDS bridge chip driver.

config DRM_IT6251
	tristate "IT6251 LVDS to DisplayPort bridge"
	depends on DRM
	select DRM_KMS_HELPER
	---help---
	  Support for IT6251 LVDS to DisplayPort encoder.
```

## drivers/gpu/galcore/Kconfig
```kconfig
menu "Vivante GPU support"

config GALCORE 
	tristate "Vivante GPU support"
	---help---
         Say Y to get the GPU driver support.

endmenu
```

## drivers/staging/etnaviv/Kconfig
```kconfig
config DRM_ETNAVIV
	tristate "etnaviv DRM"
	depends on DRM
	select SHMEM
	select TMPFS
	select IOMMU_API
	select IOMMU_SUPPORT
	default y
	help
	  DRM driver for Vivante GPUs.

config DRM_ETNAVIV_REGISTER_LOGGING
	bool "etnaviv DRM register logging"
	depends on DRM_ETNAVIV
	default n
	help
	  Compile in support for logging register reads/writes in a format
	  that can be parsed by envytools demsm tool.  If enabled, register
	  logging can be switched on via etnaviv.reglog=y module param.
```
